## base_external/package/aesdchar/Config.in
```kconfig
config BR2_PACKAGE_AESDCHAR
	bool "aesdchar"
	help
	  Includes the aesdchar driver we wrote in the kernel image.
	  Used to create a driver for the aesdsocket server.
```
